## net/wps-by-trigger/main/Kconfig.projbuild
```kconfig
menu "WPS Configuration"

if (IDF_TARGET_ESP32 || IDF_TARGET_ESP32S3)
    config TRIGER_PAD
        int "WPS triger touch pad"
        range 0 9 if IDF_TARGET_ESP32
        default 0 if IDF_TARGET_ESP32
        range 1 14 if IDF_TARGET_ESP32S3
        default 1 if IDF_TARGET_ESP32S3
        help
            Set triger touch pad (TOUCHxx) to start WPS.
endif

    config TRIGER_PIN
        int "WPS triger GPIO"
        range 0 39 if IDF_TARGET_ESP32
        range 0 21 if IDF_TARGET_ESP32C3
        range 0 48 if IDF_TARGET_ESP32S3
        default 0
        help
            Set triger GPIO number (IOxx) to start WPS.

    config TRIGER_DURATION
        int "Pressed duration to get into WPS mode."
        range 2 5
        default 2
        help
            Set a lengh to get into WPS mode.


    config LED_PIN
        int "GPIO connected to LED"
        range 0 39 if IDF_TARGET_ESP32
        range 0 21 if IDF_TARGET_ESP32C3
        range 0 48 if IDF_TARGET_ESP32S3
        default 0
        help
            Set GPIO number (IOxx) for LED.

    config ESP_MAXIMUM_RETRY
        int "Maximum retry"
        default 3
        help
            Set the Maximum retry to try reconnecting to the AP.

    config FORCE_ERASE_NVS
        bool "Erase NVS on every boot"
        default false

endmenu
```

## net/wps/main/Kconfig.projbuild
```kconfig
menu "WPS Configuration"

    config ESP_MAXIMUM_RETRY
        int "Maximum retry"
        default 3
        help
            Set the Maximum retry to try reconnecting to the AP.

    config FORCE_ERASE_NVS
        bool "Erase NVS on every boot"
        default false
endmenu
```

## peripherals/adc/simple_adc/main/Kconfig.projbuild
```kconfig
menu "ADC Config"

    config ADC1_CHANNEL
        int "ADC1 channel number"
        range 0 8 if IDF_TARGET_ESP32
        range 0 5 if IDF_TARGET_ESP32C3
        range 0 10 if IDF_TARGET_ESP32S3
        default 0
        help
            Set ADC1 channel number (ADC1_x) to read.

endmenu
```

## peripherals/touch-and-blink/main/Kconfig.projbuild
```kconfig
menu "Tuch and Blink Config"

    config TOUCH_PAD
        int "Triger touch pad number"
        range 0 9 if IDF_TARGET_ESP32
        range 0 14 if IDF_TARGET_ESP32S3
        default 0
        help
            Set touch pad number (TOUCHx) to blink.

    config GPIO_LED
        int "Blink LED gpio number"
        range 0 48
        default 0 if IDF_TARGET_ESP32
        default 45 if IDF_TARGET_ESP32S3
        default 5
        help
            Set GPIO number (IOxx) to blink.

endmenu
```

## proj-template/main/Kconfig.projbuild
```kconfig
menu "Blink Config"

    config BLINK_GPIO
        int "Blink GPIO number"
        range 0 38
        default 5
        help
            Set GPIO number (IOxx) to blink.

    config BLINK_PERIOD
        int "Blink period"
        range 1000 10000
        help
            Set blink period in sec..

endmenu
```

## rmt/ir_remote/main/Kconfig.projbuild
```kconfig
menu "IR Remote Configuration"

    config IR_TRIGER_GPIO
        int "IR Triger GPIO"
        default 5

    config IR_TX_GPIO
        int "IR TX GPIO"
        default 2

    config IR_RX_GPIO
        int "IR RX GPIO"
        default 19

    config IR_TX_CHANNEL
        int "IR TX Channel Number"
        default 0

    config IR_RX_CHANNEL
        int "IR RX Channel Number"
        default 1

endmenu
```

## spi/spi_read_temp/main/Kconfig.projbuild
```kconfig
menu "SPI Example Configuration"

    config SPI_CLK
        int "CLK GPIO Num"
        default 23
        help
            GPIO number for SPI clock line.

    config SPI_MOSI
        int "MOSI GPIO Num"
        default 22
        help
            GPIO number for SPI MOSI line.

    config SPI_MISO
        int "MISO GPIO Num"
        default 21
        help
            GPIO number for SPI MISO line.

    config SPI_CS
        int "CS GPIO Num"
        default 19
        help
            GPIO number for SPI CS line.

endmenu
```
