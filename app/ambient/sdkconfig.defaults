## app/ambient/sdkconfig.defaults
```kconfig
CONFIG_LWIP_DHCP_DOES_ARP_CHECK=n
# Fix Request Header Fields Too Large
CONFIG_HTTPD_MAX_REQ_HDR_LEN=1024
```

## app/enviroment/main/Kconfig.projbuild
```kconfig
menu "Enviroment Reporting Configuration"

    config SPREADSHEET_API_URL
        string "Google Spreadsheet Web Apps URL"
        default ""

    config SECRET_TOKEN
        string "Token to limit access"
        default "Secret_Token"

    config SLEEP_LENGTH
        int "Reporting interval (min.)"
        default 20
        help
            Sleep length in minutes.

endmenu
```

## app/google/main/Kconfig.projbuild
```kconfig
menu "IoT sample Configuration"

    config SLEEP_LENGTH
        int "Sleep duration (min.)"
        default 20
        help
            Sleep length in minutes.

endmenu
```

## app/twitter/main/Kconfig.projbuild
```kconfig
menu "IoT sample Configuration"

    config SLEEP_LENGTH
        int "Sleep duration (min.)"
        default 10
        help
            Sleep length in minutes.

endmenu
```

## components/i2c_master/Kconfig.projbuild
```kconfig
menu "I2C Master Configuration"

    config I2C_MASTER_SCL
        int "SCL GPIO Num"
        default 6 if IDF_TARGET_ESP32C3
        default 19 if IDF_TARGET_ESP32 || IDF_TARGET_ESP32S2 || IDF_TARGET_ESP32S3
        help
            GPIO number for I2C Master clock line.

    config I2C_MASTER_SDA
        int "SDA GPIO Num"
        default 5 if IDF_TARGET_ESP32C3
        default 18 if IDF_TARGET_ESP32 || IDF_TARGET_ESP32S2 || IDF_TARGET_ESP32S3
        help
            GPIO number for I2C Master data line.

    config I2C_FREQ_HZ
        int "I2C Freq in kHz"
        range 1 1000
        default 100
        help
            I2C frequency

    config I2C_PORT
        int "I2C Port Num"
        range 0 1 if IDF_TARGET_ESP32 || IDF_TARGET_ESP32
        range 0 0 if IDF_TARGET_ESP32C3
        default 0
        help
            I2C port number

    config I2C_PULLUP
        bool "Use internal Pull-up"
        default true
        help
            Use internal pull-up or not

endmenu
```

## components/ns_adt7410/Kconfig
```kconfig
menu "NS ADT7410 Configuration"

    choice
        prompt "Address of ADT7410"

        config ADT7410_AT_0x48
            bool "0x48"

        config ADT7410_AT_0x49
            bool "0x49"

        config ADT7410_AT_0x4A
            bool "0x4A"

        config ADT7410_AT_0x4B
            bool "0x4B"

    endchoice

endmenu
```

## components/ns_ambient/Kconfig
```kconfig
menu "NS Ambient"

   config AMBIENT_CHANNEL_ID
      string "Channel ID"
      default 0
      help
         Channel ID

   config AMBIENT_WRITE_KEY
      string "Write Key"
      default ""
      help
         Write key

endmenu
```

## components/ns_coap/Kconfig
```kconfig
menu "NS CoAP Configuration"

    config COAP_URI
        string "CoAP Server URI"
        default ""

endmenu
```

## components/ns_google_api/Kconfig
```kconfig
menu "NS Google OAuth 2.0 Client Configuration"

    config GOOGLE_CLIENT_ID
        string "Clinet ID"
        default ""
        help
            Set Client ID.

    config GOOGLE_CLIENT_SECRET
        string "Client Secret"
        default ""
        help
            Set client secret.

    config GOOGLE_REFHRESH_TOKEN
        string "Initial refresh token"
        default ""
        help
            Set initial refresh token.

    config GOOGLE_TOKEN_EXPIRE_TIME
        int "Valid token duration"
        default 3600
        help
            Token expires in this.

endmenu
```

## components/ns_mdns/Kconfig
```kconfig
menu "NS mDNS Configuration"

    config MDNS_HOSTNAME
        string "mDNS Hostname"
        default "esp32"
        help
            mDNS Hostname.

    config MDNS_INSTANCE
        string "mDNS Instance Name"
        default "ESP32 IoT"
        help
            mDNS Instance Name

endmenu
```

## components/ns_sht4x/Kconfig
```kconfig
menu "NS SHT4x Configuration"

    choice
        prompt "Measurement repeatability"

        config SHT4X_HIGH_REPEATABILITY
            bool "High"

        config SHT4X_MEDIUM_REPEATABILITY
            bool "Medium"

        config SHT4X_LOW_REPEATABILITY
            bool "Low"

    endchoice

endmenu
```

## components/ns_shtc3/Kconfig
```kconfig
menu "NS SHTC3 Configuration"

    config SHTC3_LOW_POWER_MODE
        bool "Use low power measure mode"
        default true
        help
            Use low power measure mode. Low power consumption but low resolution.

    config SHTC3_USE_STRETCH
        bool "Use I2C clock stretch waiting for measure."
        default true
        help
            Use I2C clock stretch.

endmenu
```

## components/ns_sntp/Kconfig
```kconfig
menu "NS SNTP Configuration"

    config TIME_ZONE
        string "Time Zone"
        default "JST-9"
        help
            Set a local time zone.

    config SNTP_SERVER
        string "SNTP Server Name"
        default "ntp.nict.jp"
        help
            Set an upstream server name.

    config SNTP_ONESHOT
        bool "Stop SNTP when synced"
        default true
        help
            Set Keep sysncing or one shot.
            If you keep SNTP running, stop SNTP before disconnecting from network.

    config SNTP_INTERVAL
        int "Sync interval"
        default 3600
        help
            Set syncing interval

endmenu
```

## components/ns_twitter/Kconfig
```kconfig
menu "Twitter Client Configuration"

    config CONSUMER_TOKEN
        string "Consumer Token"
        default "xvz1evFS4wEEPTGEFPHBog"
        help
            Set consumer token.

    config CONSUMER_SECRET
        string "Consumer Secret"
        default "kAcSOqF21Fu85e7zjz7ZN2U4ZRhfV3WpwPAoE3Z7kBw"
        help
            Set consumer secret.

    config OAUTH_TOKEN
        string "OAuth Token"
        default "370773112-GmHxMAgYyLbNEtIKZeRNFsMKPR9EyMZeS9weJAEb"
        help
            Set OAuth token.

    config OAUTH_SECRET
        string "OAuth Token Secret"
        default "LswwdoUaIvS8ltyTt5jkRh4J50vUPVVHtR2YPi5kE"
        help
            Set OAuth token secret.

endmenu
```

## components/ns_twitter2/Kconfig
```kconfig
menu "NS Twitter OAuth 2.0 Client Configuration"

    config TWITTER_PRIVATE_CLIENT
        bool "Private Client"
        default false
        help
            Private client has a risk to expose Client Secret key.

    config TWITTER_CLIENT_ID
        string "Clinet ID"
        default ""
        help
            Set Client ID.

if TWITTER_PRIVATE_CLIENT
    config TWITTER_CLIENT_SECRET
        string "Client Secret"
        default ""
        help
            Set client secret.
endif

    config TWITTER_REFHRESH_TOKEN
        string "Initial refresh token"
        default ""
        help
            Set initial refresh token.

    config TWITTER_TOKEN_EXPIRE_TIME
        int "Valid token duration"
        default 7200
        help
            Token expires in this.

endmenu
```

## components/ns_wifi/Kconfig
```kconfig
menu "NS WiFi Configuration"

   choice
      prompt "Access point and Password"

      config USE_WPS
         bool "Use WPS button to connect"

      config USE_SOFTAP
         bool "Select AP from Web."

   endchoice

   if USE_SOFTAP
    config INIT_WIFI_SSID
        string "WiFi Access Point"
        default "myssid"
        help
            Access Point name (SSID)

    config INIT_WIFI_PASSWORD
        string "WiFi Password"
        default "mypassword"
        help
            WiFi password for WPA or WPA2

   config MAX_AP_CONNECT
        int "Max connection size to AP"
        range 0 8
        default 3
        help
            Max number of connections to APs.

   config SCAN_AP_LIST_SIZE
        int "Max scan AP list size"
        range 0 20
        default 10
        help
            Max number of detecting APs.

   endif

   config TRIGER_PIN
       int "Triger GPIO to get into AP select mode"
        range 0 39 if IDF_TARGET_ESP32
        range 0 21 if IDF_TARGET_ESP32C3
        range 0 48 if IDF_TARGET_ESP32S3
        default 0
        help
           Set triger GPIO number(IOxx) to start AP choice.

    config TRIGER_DURATION
       int "Pressed duration to start AP select mode"
        range 2 5
        default 2
        help
           Set a lengh to get into AP select mode.

    config LED_PIN
       int "GPIO connected to LED"
        range 0 39 if IDF_TARGET_ESP32
        range 0 21 if IDF_TARGET_ESP32C3
        range 0 48 if IDF_TARGET_ESP32S3
        default 0
        help
           Set GPIO number (IOxx) for LED.

    config ESP_MAXIMUM_RETRY
       int "Maximum retry"
        default 3
        help
           Set the Maximum retry to try reconnecting to the AP.

    config FORCE_ERASE_NVS
       bool "Erase NVS on every boot"
        default false

endmenu
```

## components/ns_wifi/sdkconfig.defaults
```kconfig
# Copy this into project top dir.

CONFIG_LWIP_DHCP_DOES_ARP_CHECK=n
# Fix Request Header Fields Too Large
CONFIG_HTTPD_MAX_REQ_HDR_LEN=1024

# (Top) → Serial flasher config → Flash size
CONFIG_ESPTOOLPY_FLASHSIZE_4MB=y

# (Top) → Partition Table → Partition Table
CONFIG_PARTITION_TABLE_CUSTOM=y
```

## gpio/blink/main/Kconfig.projbuild
```kconfig
menu "Blink Config"

    config BLINK_GPIO
        int "Blink GPIO number"
        range 0 48
        default 0 if IDF_TARGET_ESP32
        default 8 if IDF_TARGET_ESP32C3
        default 45 if IDF_TARGET_ESP32S3
        default 5
        help
            Set GPIO number (IOxx) to blink.

    config BLINK_PERIOD
        int "Blink period"
        range 1000 10000
        help
            Set blink period in sec..

endmenu
```

## gpio/button/main/Kconfig.projbuild
```kconfig
menu "Button Sample Configuration"

    config BUTTON_PIN
        int "Button GPIO"
        range 0 39 if IDF_TARGET_ESP32
        range 0 21 if IDF_TARGET_ESP32C3
        range 0 48 if IDF_TARGET_ESP32S3
        default 0
        help
            Set Button GPIO number (IOxx).

    config LONG_DURATION
        int "Long pressed duration"
        range 2 6
        default 2
        help
            Set a lengh for long press.


    config LED_PIN
        int "GPIO connected to LED"
        range 0 39 if IDF_TARGET_ESP32
        range 0 21 if IDF_TARGET_ESP32C3
        range 0 48 if IDF_TARGET_ESP32S3
        default 0
        help
            Set GPIO number (IOxx) for LED.

    config BLINK_PERIOD
        int "Blink period as ms"
        range 100 1000
        default 500
        help
            Set blink period.

endmenu
```

## gpio/deep-sleep/main/Kconfig.projbuild
```kconfig
menu "Deep Sleep Sample"

   choice
      prompt "Wakeup Source"
      default WAKEUP_GPIO

      config WAKEUP_GPIO
         bool "Wakeup by GPIO"

      config WAKEUP_TOUCH
         bool "Wakeup by Touchpad"

   endchoice

if WAKEUP_GPIO
   config TRIGER_PIN
      int "Wakeup Triger GPIO"
      range 0 39 if IDF_TARGET_ESP32
      range 0 21 if IDF_TARGET_ESP32C3
      range 0 48 if IDF_TARGET_ESP32S3
      default 15 if IDF_TARGET_ESP32
      default 0 if IDF_TARGET_ESP32S3
      help
         Set triger GPIO number(IOxx) to wakeup. This GPIO also must be RTC_GPIO.
endif

if WAKEUP_TOUCH
   config TOUCH_PAD
      int "Wakeup Touchpad (TOUCHx)"
      range 0 9 if IDF_TARGET_ESP32
      range 0 14 if IDF_TARGET_ESP32S3
      default 0
      help
         Set touch pad number (TOUCHx) to wakeup.
endif

   config WAKEUP_TIMER
      bool "Wakeup Timer"
      default true

if WAKEUP_TIMER
   config SLEEP_DURATION
      int "Sleep duration (sec)"
      range 1 3600
      default 30
endif

   config LED_PIN
      int "GPIO connected to LED"
      range 0 39 if IDF_TARGET_ESP32
      range 0 21 if IDF_TARGET_ESP32C3
      range 0 48 if IDF_TARGET_ESP32S3
      default 2 if IDF_TARGET_ESP32
      default 45 if IDF_TARGET_ESP32S3
      help
         Set GPIO number (IOxx) for LED.

endmenu
```

## net/http-server/main/Kconfig.projbuild
```kconfig
menu "HTTP Server Configuration"

    config MDNS_HOSTNAME
        string "mDNS Hostname"
        default "esp32"
        help
            mDNS Hostname

    config MDNS_INSTANCE
        string "mDNS Instance Name"
        default "ESP32 HTTP Server"
        help
            mDNS Instance Name

    config BUTTON_PIN
        int "WPS triger GPIO"
        range 0 39 if IDF_TARGET_ESP32
        range 0 21 if IDF_TARGET_ESP32C3
        range 0 48 if IDF_TARGET_ESP32S3
        default 0
        help
            Set triger GPIO number (IOxx) to start WPS.

    config LONG_DURATION
        int "Pressed duration to get into WPS mode."
        range 2 5
        default 2
        help
            Set a lengh to get into WPS mode.


    config LED_PIN
        int "GPIO connected to LED"
        range 0 39 if IDF_TARGET_ESP32
        range 0 21 if IDF_TARGET_ESP32C3
        range 0 48 if IDF_TARGET_ESP32S3
        default 0
        help
            Set GPIO number (IOxx) for LED.

    config ESP_MAXIMUM_RETRY
        int "Maximum retry"
        default 3
        help
            Set the Maximum retry to try reconnecting to the AP.

    config FORCE_ERASE_NVS
        bool "Erase NVS on every boot"
        default false

endmenu
```

## net/mqtt/main/Kconfig.projbuild
```kconfig
menu "MQTT Configuration"

    config BROKER_URL
        string "Broker URL"
        default "mqtt://test.mosquitto.org:1883/"
        help
            URL of a MQTT broker.

    config SPI_CLK
        int "CLK GPIO Num"
        default 23
        help
            GPIO number for SPI clock line.

    config SPI_MOSI
        int "MOSI GPIO Num"
        default 22
        help
            GPIO number for SPI MOSI line.

    config SPI_MISO
        int "MISO GPIO Num"
        default 21
        help
            GPIO number for SPI MISO line.

    config SPI_CS
        int "CS GPIO Num"
        default 19
        help
            GPIO number for SPI CS line.

    config TIME_ZONE
        string "Time Zone"
        default "JST-9"
        help
            Set a local time zone.

    config SNTP_SERVER
        string "SNTP Server Name"
        default ntp.nict.jp
        help
            Set an upstream server name.

    config TRIGER_PIN
        int "WPS triger GPIO"
        range 0 39 if IDF_TARGET_ESP32
        range 0 21 if IDF_TARGET_ESP32C3
        range 0 48 if IDF_TARGET_ESP32S3
        default 0
        help
            Set triger GPIO number (IOxx) to start WPS.

    config TRIGER_DURATION
        int "Pressed duration to get into WPS mode."
        range 2 5
        default 2
        help
            Set a lengh to get into WPS mode.


    config LED_PIN
        int "GPIO connected to LED"
        range 0 39 if IDF_TARGET_ESP32
        range 0 21 if IDF_TARGET_ESP32C3
        range 0 48 if IDF_TARGET_ESP32S3
        default 0
        help
            Set GPIO number (IOxx) for LED.

    config ESP_MAXIMUM_RETRY
        int "Maximum retry"
        default 3
        help
            Set the Maximum retry to try reconnecting to the AP.

    config FORCE_ERASE_NVS
        bool "Erase NVS on every boot"
        default false

endmenu
```
